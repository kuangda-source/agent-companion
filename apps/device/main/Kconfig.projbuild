## apps/device/main/Kconfig.projbuild
```kconfig
menu "Agent Companion"
config AC_BOARD_PROBE_ONLY
    bool "Build the minimal board probe instead of the complete shared UI"
    default n
endmenu
```

## apps/device/sdkconfig.defaults
```kconfig
CONFIG_IDF_TARGET="esp32p4"
CONFIG_ESPTOOLPY_FLASHMODE_QIO=y
CONFIG_ESPTOOLPY_FLASHSIZE_32MB=y
CONFIG_BOOTLOADER_LOG_LEVEL_WARN=y
CONFIG_PARTITION_TABLE_CUSTOM=y
CONFIG_PARTITION_TABLE_CUSTOM_FILENAME="partitions.factory.csv"
CONFIG_PARTITION_TABLE_OFFSET=0x9000
CONFIG_COMPILER_OPTIMIZATION_PERF=y
CONFIG_SPIRAM=y
CONFIG_SPIRAM_SPEED_200M=y
# Keep large read-only fonts/sprites in flash for the initial resource budget.
# CONFIG_SPIRAM_XIP_FROM_PSRAM is not set
CONFIG_CACHE_L2_CACHE_256KB=y
CONFIG_CACHE_L2_CACHE_LINE_128B=y
CONFIG_ESP_MAIN_TASK_STACK_SIZE=10240
CONFIG_FREERTOS_HZ=1000
CONFIG_LV_USE_CLIB_MALLOC=y
CONFIG_LV_USE_CLIB_STRING=y
CONFIG_LV_USE_CLIB_SPRINTF=y
CONFIG_LV_DEF_REFR_PERIOD=16
CONFIG_LV_OS_FREERTOS=y
CONFIG_LV_FONT_MONTSERRAT_20=y
CONFIG_LV_USE_FONT_COMPRESSED=y
CONFIG_LV_FONT_FMT_TXT_LARGE=y
CONFIG_LV_USE_RLE=y
CONFIG_LV_BIN_DECODER_RAM_LOAD=y
CONFIG_LV_USE_SNAPSHOT=y
CONFIG_SPIRAM_USE_MALLOC=y
CONFIG_SPIRAM_MALLOC_ALWAYSINTERNAL=16384
CONFIG_ESP_CONSOLE_UART_DEFAULT=y
CONFIG_ESP_CONSOLE_SECONDARY_USB_SERIAL_JTAG=y
# CONFIG_LV_USE_DEMO_WIDGETS is not set
# CONFIG_LV_USE_DEMO_MUSIC is not set
# CONFIG_LV_USE_PERF_MONITOR is not set

# Hosted C6 SDIO matches 7B factory pinout. TLS always checks CA and hostname.
CONFIG_ESP_HOSTED_SDIO_HOST_INTERFACE=y
CONFIG_ESP_HOSTED_SDIO_GPIO_RESET_SLAVE=54
CONFIG_ESP_HOSTED_SDIO_PIN_CMD=19
CONFIG_ESP_HOSTED_SDIO_PIN_CLK=18
CONFIG_ESP_HOSTED_SDIO_PIN_D0=14
CONFIG_ESP_HOSTED_SDIO_PRIV_PIN_D1_4BIT_BUS=15
CONFIG_ESP_HOSTED_SDIO_PIN_D2=16
CONFIG_ESP_HOSTED_SDIO_PIN_D3=17
CONFIG_MBEDTLS_CERTIFICATE_BUNDLE=y
CONFIG_MBEDTLS_CERTIFICATE_BUNDLE_DEFAULT_FULL=y
# Heartbeats must be able to transmit while the receive task waits for TLS data.
CONFIG_ESP_WS_CLIENT_SEPARATE_TX_LOCK=y

CONFIG_SPIRAM_ALLOW_BSS_SEG_EXTERNAL_MEMORY=y
```
